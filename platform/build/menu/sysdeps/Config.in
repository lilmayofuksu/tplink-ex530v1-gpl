## platform/build/menu/sysdeps/Config.in
```kconfig
#
# For a description of the syntax of this configuration file,
# see scripts/kbuild/config-language.txt.
#

mainmenu "Platform Configuration"

config HAVE_DOT_CONFIG
	bool
	default y

source menu/sysdeps/General.in

#source archival/Config.in

source menu/sysdeps/WAN.in

source menu/sysdeps/ETH.in

source menu/sysdeps/WLAN.in

source menu/sysdeps/LTE.in

source menu/sysdeps/DSL.in

source menu/sysdeps/PON.in

source menu/sysdeps/GPIO.in

source menu/sysdeps/IPv6.in

source menu/sysdeps/USB.in

source menu/sysdeps/VoIP.in

source menu/sysdeps/Functions.in

source menu/sysdeps/Mesh.in

source menu/sysdeps/Web.in

source menu/sysdeps/Debug.in

source menu/sysdeps/OEM.in

source menu/sysdeps/Schedule.in

source menu/sysdeps/TEST.in

source menu/sysdeps/ISP.in

source menu/sysdeps/SPEC.in

source menu/sysdeps/Account.in
```

## sdk/en7529/linux-4.4.115/Kconfig.tp
```kconfig
menu "TP-LINK Configure"

config TP_EASYMESH
	bool "Support TP-LINK Easymesh"
	default n

config HYFI_BRIDGE
	bool "Linux Bridge Hyfi-bridge Support"
	default n

config QOE
	bool "Support TPUC Wi-Fi QoE related info"
	default n

config TP_FIREWALL_LOG
	bool "Support advanced firewall log"
	default n

config TP_FIREWALL_LOG_MARK
	string "Mark added in front of firewall log"
	default "1F1W4L5O1G4"
	depends on TP_FIREWALL_LOG
	help
	   We add mark in front of the origin firewall log, \
	   and we also filter out firewall log from kmsg through the mark.

endmenu
```
